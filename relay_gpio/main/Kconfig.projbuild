## relay_gpio/main/Kconfig.projbuild
```kconfig
menu "Example Configuration"

    orsource "$IDF_PATH/examples/common_components/env_caps/$IDF_TARGET/Kconfig.env_caps"

    config GPIO_OUTPUT_0
        int "GPIO output pin 0"
        range ENV_GPIO_RANGE_MIN ENV_GPIO_OUT_RANGE_MAX
        default 8 if IDF_TARGET_ESP32C2 || IDF_TARGET_ESP32H2 || IDF_TARGET_ESP32C5 || IDF_TARGET_ESP32C61
        default 8 if IDF_TARGET_ESP32S3 || IDF_TARGET_ESP32H21
        default 18
        help
            GPIO pin number to be used as GPIO_OUTPUT_IO_0.

    config GPIO_OUTPUT_1
        int "GPIO output pin 1"
        range ENV_GPIO_RANGE_MIN ENV_GPIO_OUT_RANGE_MAX
        default 9 if IDF_TARGET_ESP32C2 || IDF_TARGET_ESP32H2 || IDF_TARGET_ESP32C5 || IDF_TARGET_ESP32C61
        default 9 if IDF_TARGET_ESP32S3 || IDF_TARGET_ESP32H21
        default 19
        help
            GPIO pin number to be used as GPIO_OUTPUT_IO_1.

    config GPIO_INPUT_0
        int "GPIO input pin 0"
        range ENV_GPIO_RANGE_MIN ENV_GPIO_IN_RANGE_MAX
        default 2 if IDF_TARGET_ESP32H4
        default 4
        help
            GPIO pin number to be used as GPIO_INPUT_IO_0.

    config GPIO_INPUT_1
        int "GPIO input pin 1"
        range ENV_GPIO_RANGE_MIN ENV_GPIO_IN_RANGE_MAX
        default 3 if IDF_TARGET_ESP32H4
        default 5
        help
            GPIO pin number to be used as GPIO_INPUT_IO_1.

    config SHIFT_DATA_PIN
        int "Shift register DATA (DS) pin"
        range ENV_GPIO_RANGE_MIN ENV_GPIO_OUT_RANGE_MAX
        default 11
        help
            GPIO pin number connected to 74HC595 DS (SER / DATA) pin.

    config SHIFT_CLOCK_PIN
        int "Shift register CLOCK (SHCP) pin"
        range ENV_GPIO_RANGE_MIN ENV_GPIO_OUT_RANGE_MAX
        default 10
        help
            GPIO pin number connected to 74HC595 SHCP (shift clock) pin.

    config SHIFT_LATCH_PIN
        int "Shift register LATCH (STCP) pin"
        range ENV_GPIO_RANGE_MIN ENV_GPIO_OUT_RANGE_MAX
        default 12
        help
            GPIO pin number connected to 74HC595 STCP (latch) pin.

    config BUTTON_PIN
        int "Button input pin (active high, normally low)"
        range ENV_GPIO_RANGE_MIN ENV_GPIO_IN_RANGE_MAX
        default 39
        help
            GPIO pin number connected to the button. The example expects the button to be normally high and pull to GND when pressed.

endmenu
```
